## components/camera/Kconfig.projbuild
```kconfig
menu "Camera Configuration"

        choice FRAMESIZE
            bool "Select Frame Size"
            default FRAMESIZE_VGA
            help
                Select Picture Frame Size.
    
            config FRAMESIZE_VGA
                bool "Frame Size:640x480"
            config FRAMESIZE_SVGA
                bool "Frame Size:800x600"
            config FRAMESIZE_XGA
                bool "Frame Size:1024x768"
            config FRAMESIZE_HD
                bool "Frame Size:1280x720"
            config FRAMESIZE_SXGA
                bool "Frame Size:1280x1024"
            config FRAMESIZE_UXGA
                bool "Frame Size:1600x1200"
        endchoice

        config ENABLE_FLASH
            bool "Enable Flash Light"
            default n
            help
                Enable Flash Light.

        config GPIO_FLASH
            int "Flash GPIO number"
            depends on ENABLE_FLASH
            range 4 34
            default 4
            help
                GPIO number (IOxx) to Button Input.
                Some GPIOs are used for other purposes (flash connections, etc.) and cannot be used to Button.
endmenu
```

## components/gpio_ctrl/Kconfig.projbuild
```kconfig
menu "GPIO Controller component"

config GPIO_CTRL_ENABLE
	bool "Enable GPIO Controller component"
	default y

endmenu
```

## components/telegram/Kconfig.projbuild
```kconfig
menu "Telegramm Configuration"

    config TELEGRAM_HOST
        string "TELEGRAM HOST"
        default "https://api.telegram.org"
        help
            Telegram host to connect to.

    config TELEGRAM_SSL_PORT
        int "TELEGRAM SSL PORT"
        default 443
        help
            TELEGRAM SSL PORT to use.

    config HANDLE_MESSAGES
        int "HANDLE MESSAGES"
        default 5
        help
            HANDLE MESSAGES is really inexistent.

    config TOKEN
        string "TELEGRAM TOKEN"
        default "XXXXXXXXXX:XXEFbnGn2AUXXXjpUJk5wJF8LE_sEvYYXXXs"
        help
            Telegram TOKEN to connect to.

    config CHAT_ID
        string "CHAT ID"
        default "3333333334"
        help
            Telegram CHAT ID to connect to.

    config CHAT_ID1
        string "CHAT ID1"
        default "@SSSSS_S"
        help
            Telegram NAME CHAT ID to connect to.

    config TIME_FOR_MESSAGES
        int "TIME FOR MESSAGES"
        default 1000
        help
            Time for Updates MESSAGES in ms.
endmenu
```

## main/Kconfig.projbuild
```kconfig
menu "Example Configuration"

    menu "BLINK Configuration"

        config BLINK_GPIO
            int "Blink GPIO number"
            range 0 34
            default 33
            help
                GPIO number (IOxx) to blink on and off.

                Some GPIOs are used for other purposes (flash connections, etc.) and cannot be used to blink.

                GPIOs 35-39 are input-only so cannot be used as outputs.
    endmenu
    
    menu "Sensor Configuration"

        config SENSOR_GPIO
            int "Sensor GPIO number"
            range 0 34
            default 13
            help
                GPIOs 35-39 are input-only so cannot be used as outputs.
    endmenu

    menu  "Remote File Name Setting"

        choice REMOTE_FILE
            bool "Select remote file name"
            default REMOTE_IS_FIXED_NAME
            help
                Select remote file name.

            config REMOTE_IS_FIXED_NAME
                bool "Remote file name is fixed"
            
            config REMOTE_IS_VARIABLE_NAME
                bool "Remote file name is date and time"
        endchoice

        config FIXED_REMOTE_FILE
            depends on REMOTE_IS_FIXED_NAME
            string "Fixed-Remote file name"
            default "picture.jpg"
            help
                Remote file name.

        config NTP_SERVER
            depends on REMOTE_IS_VARIABLE_NAME
            string "NTP Server"
            default "pool.ntp.org"
            help
                Hostname for NTP Server.

        config LOCAL_TIMEZONE
            depends on REMOTE_IS_VARIABLE_NAME
            int "Your TimeZone"
            range -23 23
            default 0
            help
                Your local timezone.  When it is 0, Greenwich Mean Time.

        config REMOTE_FRAMESIZE
            bool "Add FrameSize to Remote file name"
            default n
            help
                Add FrameSize to Remote file name.

    endmenu 

    config ESP_WIFI_SSID
        string "WiFi SSID"
        default "myssid"
        help
            SSID (network name) for the example to connect to.

    config ESP_WIFI_PASSWORD
        string "WiFi Password"
        default "mypassword"
        help
            WiFi password (WPA or WPA2) for the example to use.

    choice ESP_WIFI_SAE_MODE
        prompt "WPA3 SAE mode selection"
        default ESP_STATION_EXAMPLE_WPA3_SAE_PWE_BOTH
        help
            Select mode for SAE as Hunt and Peck, H2E or both.
        config ESP_STATION_EXAMPLE_WPA3_SAE_PWE_HUNT_AND_PECK
            bool "HUNT AND PECK"
        config ESP_STATION_EXAMPLE_WPA3_SAE_PWE_HASH_TO_ELEMENT
            bool "H2E"
            depends on ESP_WIFI_ENABLE_SAE_H2E
        config ESP_STATION_EXAMPLE_WPA3_SAE_PWE_BOTH
            bool "BOTH"
            depends on ESP_WIFI_ENABLE_SAE_H2E
    endchoice

    config ESP_WIFI_PW_ID
        string "PASSWORD IDENTIFIER"
        depends on  ESP_STATION_EXAMPLE_WPA3_SAE_PWE_HASH_TO_ELEMENT|| ESP_STATION_EXAMPLE_WPA3_SAE_PWE_BOTH
        default ""
        help
            password identifier for SAE H2E

    config ESP_MAXIMUM_RETRY
        int "Maximum retry"
        default 5
        help
            Set the Maximum retry to avoid station reconnecting to the AP unlimited when the AP is really inexistent.

    choice ESP_WIFI_SCAN_AUTH_MODE_THRESHOLD
        prompt "WiFi Scan auth mode threshold"
        default ESP_WIFI_AUTH_WPA2_PSK
        help
            The weakest authmode to accept in the scan mode.
            This value defaults to ESP_WIFI_AUTH_WPA2_PSK in case password is present and ESP_WIFI_AUTH_OPEN is used.
            Please select ESP_WIFI_AUTH_WEP/ESP_WIFI_AUTH_WPA_PSK in case AP is operating in WEP/WPA mode.

        config ESP_WIFI_AUTH_OPEN
            bool "OPEN"
        config ESP_WIFI_AUTH_WEP
            bool "WEP"
        config ESP_WIFI_AUTH_WPA_PSK
            bool "WPA PSK"
        config ESP_WIFI_AUTH_WPA2_PSK
            bool "WPA2 PSK"
        config ESP_WIFI_AUTH_WPA_WPA2_PSK
            bool "WPA/WPA2 PSK"
        config ESP_WIFI_AUTH_WPA3_PSK
            bool "WPA3 PSK"
        config ESP_WIFI_AUTH_WPA2_WPA3_PSK
            bool "WPA2/WPA3 PSK"
        config ESP_WIFI_AUTH_WAPI_PSK
            bool "WAPI PSK"
    endchoice

endmenu
```
